## CMakeLists.txt
```
# Author: Jack Ostapeic, MS ECE student at UW-Madison

cmake_minimum_required(VERSION 3.20.0)

find_package(Zephyr REQUIRED HINTS $ENV{ZEPHYR_BASE})
project(jack_testing)

target_sources(app PRIVATE src/main.c src/stack_overflow.c)
```

## prj.conf
```kconfig
# Configuration for Jack Testing Fault Tolerance Application
# ECE753 Project - Enhanced Fault Tolerance in Zephyr RTOS
# Author: Jack Ostapeic, MS ECE student at UW-Madison

# enable fault tolerance framework
CONFIG_FAULT_TOLERANCE=y
CONFIG_FAULT_TOLERANCE_AUTO_INIT=y
CONFIG_FAULT_TOLERANCE_INIT_PRIORITY=60

CONFIG_STACK_SENTINEL=y
CONFIG_STACK_CANARIES=y
CONFIG_THREAD_STACK_INFO=y
CONFIG_THREAD_NAME=y
CONFIG_MULTITHREADING=y
CONFIG_THREAD_ANALYZER=y
```

## src/main.c
```c
/**
 * @file main.c
 * @author Jack Ostapeic, MS ECE student at UW-Madison
 * @brief Fault Tolerance API Testing Application
 *
 * This application validates the functionality of the Fault Tolerance (FT) API
 * in the Zephyr RTOS. It includes tests for fault reporting, handler registration,
 * recovery actions, and logging mechanisms.
 */

#include <zephyr/fault_tolerance.h>
#include <zephyr/kernel.h>
#include <string.h>
#include <stdio.h>
#include "stack_overflow.h"

LOG_MODULE_REGISTER(jack_testing_main, LOG_LEVEL_INF);

int main(void)
{
    int ret;

    printk("Enhanced Fault Tolerance API Testing Application Starting...\n");

    ret = ft_init();
    printk("Fault Tolerance subsystem initialization returned: %d\n", ret);

    ret = ft_init();
    printk("Fault Tolerance subsystem re-initialization returned: %d\n", ret);

    printk("Creating stack overflow test thread...\n");
    k_thread_create(&stack_overflow_test_thread, stack_overflow_test_thread_stack,
                    THREAD_STACK_SIZE,
                    (k_thread_entry_t)stack_overflow_thread_entry,
                    (void *)0, NULL, NULL,
                    K_PRIO_COOP(10), 0, K_NO_WAIT);
    k_thread_name_set(&stack_overflow_test_thread, "ft_stack_overflow_test_thread");
    
    printk("Thread created, waiting for completion...\n");
    
    /* Wait for the thread to complete or keep the system alive */
    k_thread_join(&stack_overflow_test_thread, K_FOREVER);
    
    printk("Test thread completed. Application finished.\n");
    
    return 0;
}
```

## src/stack_overflow.c
```c
#include <zephyr/fault_tolerance.h>
#include <zephyr/logging/log.h>
#include "stack_overflow.h"

LOG_MODULE_REGISTER(stack_overflow_test, LOG_LEVEL_INF);

K_THREAD_STACK_DEFINE(stack_overflow_test_thread_stack, THREAD_STACK_SIZE);
struct k_thread stack_overflow_test_thread;

void recursive_bomb(int depth)
{
    volatile char buffer[200];
    for (int i = 0; i < 200; i++) {
        buffer[i] = (depth + i) & 0xFF;
    }

    size_t unused; 
    if (k_thread_stack_space_get(k_current_get(), &unused) == 0) {
        printk("Unused stack: %zu bytes\n", unused);
    }

    printk("Recursion depth: %d\n", depth);
    
    /* Add a limit to prevent infinite recursion for testing */
    if (depth > 10) {
        printk("Reached maximum test depth, stopping recursion\n");
        return;
    }
    
    k_yield();
    recursive_bomb(depth + 1);
}

void stack_overflow_thread_entry(void *p1, void *p2, void *p3)
{
    LOG_INF("Test thread started - triggering controlled stack overflow test...");
    printk("Stack overflow test thread starting...\n");
    recursive_bomb(0);
    printk("Stack overflow test completed successfully\n");
}
```

## src/stack_overflow.h
```c
#ifndef STACK_OVERFLOW_H
#define STACK_OVERFLOW_H

#include <zephyr/kernel.h>

#define THREAD_STACK_SIZE 1024

/* External declarations for stack overflow test */
extern k_thread_stack_t stack_overflow_test_thread_stack[K_THREAD_STACK_LEN(THREAD_STACK_SIZE)];
extern struct k_thread stack_overflow_test_thread;
extern void stack_overflow_thread_entry(void *p1, void *p2, void *p3);

#endif /* STACK_OVERFLOW_H */
```
