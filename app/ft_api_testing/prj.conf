## CMakeLists.txt
```
# Author: Jack Ostapeic, MS ECE student at UW-Madison

cmake_minimum_required(VERSION 3.20.0)

find_package(Zephyr REQUIRED HINTS $ENV{ZEPHYR_BASE})
project(ft_api_testing)

target_sources(app PRIVATE src/main.c)
```

## prj.conf
```kconfig
# Configuration for Fault Tolerance API Testing Application
# ECE753 Project - Enhanced Fault Tolerance in Zephyr RTOS
# Author: Jack Ostapeic, MS ECE student at UW-Madison

# enable fault tolerance framework
CONFIG_FAULT_TOLERANCE=y
# CONFIG_FAULT_TOLERANCE_AUTO_INIT=n
# CONFIG_FAULT_TOLERANCE_INIT_PRIORITY=50
# CONFIG_FAULT_TOLERANCE_STACK_MONITORING=y
# CONFIG_FAULT_TOLERANCE_MEMORY_MONITORING=y
# CONFIG_FAULT_TOLERANCE_TIMING_MONITORING=y
# CONFIG_FAULT_TOLERANCE_STATISTICS=y
# CONFIG_FAULT_TOLERANCE_AUTO_RECOVERY=y

# enable multithreading support
CONFIG_MULTITHREADING=y
CONFIG_THREAD_STACK_INFO=y
CONFIG_THREAD_NAME=y
CONFIG_THREAD_MAX_NAME_LEN=32

# memory management features
# CONFIG_HEAP_MEM_POOL_SIZE=8192
# CONFIG_SYSTEM_WORKQUEUE_STACK_SIZE=2048

# logging configuration
CONFIG_PRINTK=y
CONFIG_LOG=y
CONFIG_LOG_DEFAULT_LEVEL=3
# CONFIG_LOG_PRINTK=y
# CONFIG_LOG_PROCESS_THREAD_STACK_SIZE=2048

# console and shell support
CONFIG_CONSOLE=y
CONFIG_UART_CONSOLE=y

# enable printk for output


# random number generator for testing
# CONFIG_TEST_RANDOM_GENERATOR=y

# increase main stack size for testing
CONFIG_MAIN_STACK_SIZE=4096

# enable assert for debugging
CONFIG_ASSERT=y

# enable basic fault handling
# CONFIG_RUNTIME_ERROR_CHECK=y

# watchdog support
# CONFIG_TASK_WDT=y
```

## src/main.c
```c
/**
 * @file main.c
 * @author Jack Ostapeic, MS ECE student at UW-Madison
 * @brief Fault Tolerance API Testing Application
 *
 * This application validates the functionality of the Fault Tolerance (FT) API
 * in the Zephyr RTOS. It includes tests for fault reporting, handler registration,
 * recovery actions, and logging mechanisms.
 */

#include <zephyr/fault_tolerance.h>
#include <zephyr/kernel.h>
#include <zephyr/logging/log.h>
// #include <logging/log.h>

#include <string.h>
#include <stdio.h>

LOG_MODULE_REGISTER(ft_api_testing, LOG_LEVEL_INF);

#define THREAD_STACK_SIZE 1024

K_THREAD_STACK_DEFINE(test_thread_stack, THREAD_STACK_SIZE);
static struct k_thread test_thread;

void thread_entry(void *p1, void *p2, void *p3)
{
    LOG_INF("Test thread started - triggering stack overflow...\n");
    recursive_bomb(0);
}

void recursive_bomb(int depth)
{
    volatile char buffer[200];
    for (int i = 0; i < 200; i++) {
        buffer[i] = (depth + i) & 0xFF;
    }

    size_t unused;
    if (k_thread_stack_space_get(k_current_get(), &unused) == 0) {
        printk("Unused stack: %zu bytes\n", unused);
    }

    printk("Recursion depth: %d\n", depth);
    k_yield();
    recursive_bomb(depth + 1);
}

int main(void)
{
    int ret;

    printk("Enhanced Fault Tolerance API Testing Application Starting...\n");

    ret = ft_init();
    printk("Fault Tolerance subsystem initialization returned: %d\n", ret);

    ret = ft_init();
    printk("Fault Tolerance subsystem re-initialization returned: %d\n", ret);

    k_thread_create(&test_thread, test_thread_stack, THREAD_STACK_SIZE,
                    (k_thread_entry_t)thread_entry, (void *)0, NULL, NULL,
                    K_PRIO_COOP(5), 0, K_NO_WAIT);

    k_thread_name_set(&test_thread, "ft_test_thread");

    while (1) {
        k_sleep(K_MSEC(1000));
    }

    return 0;
}
```
