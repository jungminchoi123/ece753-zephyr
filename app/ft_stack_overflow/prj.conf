## CMakeLists.txt
```
# Author: Jack Ostapeic, MS ECE student at UW-Madison

cmake_minimum_required(VERSION 3.20.0)

find_package(Zephyr REQUIRED HINTS $ENV{ZEPHYR_BASE})
project(ft_stack_overflow)

target_sources(app PRIVATE src/main.c)
```

## prj.conf
```kconfig
# Configuration for Fault Tolerance API Testing Application
# ECE753 Project - Enhanced Fault Tolerance in Zephyr RTOS
# Author: Jack Ostapeic, MS ECE student at UW-Madison

# enable fault tolerance framework
CONFIG_FAULT_TOLERANCE=y
CONFIG_FAULT_TOLERANCE_AUTO_INIT=y
CONFIG_FAULT_TOLERANCE_INIT_PRIORITY=60
CONFIG_FT_ENABLE_STACK_OVERFLOW_PROTECTION=y

CONFIG_STACK_SENTINEL=y
CONFIG_STACK_CANARIES=y
CONFIG_THREAD_STACK_INFO=y
CONFIG_THREAD_MONITOR=y
CONFIG_MAIN_STACK_SIZE=1024
CONFIG_BOOT_BANNER=y



# enable logging and console output
CONFIG_PRINTK=y
CONFIG_LOG=y
CONFIG_LOG_DEFAULT_LEVEL=3
CONFIG_CONSOLE=y
CONFIG_UART_CONSOLE=y
```

## src/main.c
```c
#include <zephyr/kernel.h>
#include <zephyr/logging/log.h>

LOG_MODULE_REGISTER(ft_test_app, LOG_LEVEL_INF);

#define OVERFLOW_STACK_SIZE 1024
K_THREAD_STACK_DEFINE(overflow_stack, OVERFLOW_STACK_SIZE);
static struct k_thread overflow_thread;

__attribute__((noinline)) void recursive_overflow(int depth) {
    volatile char buffer[256];  // volatile prevents optimization
    buffer[0] = depth;
    printk("Recursion depth: %d\n", depth);
    recursive_overflow(depth + 1);
}

void overflow_entry(void *p1, void *p2, void *p3) {
    LOG_INF("Overflow thread started");
    recursive_overflow(0);
}

void main(void) {
    LOG_INF("Starting FT stack overflow test...");

    k_thread_create(&overflow_thread, overflow_stack, OVERFLOW_STACK_SIZE,
                    overflow_entry, NULL, NULL, NULL,
                    K_PRIO_COOP(3), 0, K_NO_WAIT);

    k_thread_name_set(&overflow_thread, "overflow_thread");

    while (1) {
        k_sleep(K_SECONDS(1));
    }
}
```
