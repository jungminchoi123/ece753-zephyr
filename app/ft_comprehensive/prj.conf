## CMakeLists.txt
```
cmake_minimum_required(VERSION 3.20.0)
find_package(Zephyr REQUIRED HINTS $ENV{ZEPHYR_BASE})
project(ft_comprehensive_test)

target_sources(app PRIVATE src/main.c)
target_sources(app PRIVATE src/deadlock_test.c)
target_sources(app PRIVATE src/buffer_overflow_test.c)
target_sources(app PRIVATE src/memory_leak_test.c)
target_sources(app PRIVATE src/timing_violation_test.c)
```

## prj.conf
```kconfig
# Comprehensive Fault Tolerance Test Application Configuration

# Enable fault tolerance framework
CONFIG_FAULT_TOLERANCE=y
CONFIG_FAULT_TOLERANCE_AUTO_INIT=y

# Enable all fault detection modules
CONFIG_FT_ENABLE_STACK_OVERFLOW_PROTECTION=y
CONFIG_FT_ENABLE_DEADLOCK_DETECTION=y
CONFIG_FT_ENABLE_BUFFER_OVERFLOW_PROTECTION=y
CONFIG_FT_ENABLE_MEMORY_LEAK_DETECTION=y
CONFIG_FT_ENABLE_TIMING_VIOLATION_DETECTION=y

# Fault thresholds and tuning
CONFIG_FT_STACK_OVERFLOW_THRESHOLD=128
CONFIG_FT_DEADLOCK_TIMEOUT_MS=5000
CONFIG_FT_BUFFER_OVERFLOW_CANARY_SIZE=8
CONFIG_FT_MEMORY_LEAK_THRESHOLD=1024
CONFIG_FT_TIMING_VIOLATION_THRESHOLD_MS=1000

# Thread monitoring and stack info
CONFIG_THREAD_STACK_INFO=y
CONFIG_THREAD_MONITOR=y

# Logging configuration
CONFIG_LOG=y
CONFIG_LOG_RUNTIME_FILTERING=y

# System configuration
CONFIG_MAIN_STACK_SIZE=4096
CONFIG_SYSTEM_WORKQUEUE_STACK_SIZE=2048

# Memory management
CONFIG_HEAP_MEM_POOL_SIZE=16384

# Timing and scheduling
CONFIG_TIMER_RANDOM_GENERATOR=y
CONFIG_TEST_CSPRNG_GENERATOR=y

# Enable assertions for debugging
CONFIG_ASSERT=y
```

## src/main.c
```c
#include <zephyr/kernel.h>
#include <zephyr/logging/log.h>
#include <zephyr/fault_tolerance.h>
#include <zephyr/sys/reboot.h>

LOG_MODULE_REGISTER(ft_comprehensive, LOG_LEVEL_INF);

/* Test control flags - can be configured at compile time */
#ifdef CONFIG_FT_ENABLE_STACK_OVERFLOW_PROTECTION
#define RUN_STACK_OVERFLOW_TEST 1
#else
#define RUN_STACK_OVERFLOW_TEST 0
#endif

#ifdef CONFIG_FT_ENABLE_DEADLOCK_DETECTION  
#define RUN_DEADLOCK_TEST 1
#else
#define RUN_DEADLOCK_TEST 0
#endif

#ifdef CONFIG_FT_ENABLE_BUFFER_OVERFLOW_PROTECTION
#define RUN_BUFFER_OVERFLOW_TEST 1
#else
#define RUN_BUFFER_OVERFLOW_TEST 0
#endif

#ifdef CONFIG_FT_ENABLE_MEMORY_LEAK_DETECTION
#define RUN_MEMORY_LEAK_TEST 1
#else
#define RUN_MEMORY_LEAK_TEST 0
#endif

#ifdef CONFIG_FT_ENABLE_TIMING_VIOLATION_DETECTION
#define RUN_TIMING_VIOLATION_TEST 1
#else
#define RUN_TIMING_VIOLATION_TEST 0
#endif

/* Thread stacks and structures */
#define TEST_THREAD_STACK_SIZE 2048
#define MAX_TEST_THREADS 5

static K_THREAD_STACK_ARRAY_DEFINE(test_stacks, MAX_TEST_THREADS, TEST_THREAD_STACK_SIZE);
static struct k_thread test_threads[MAX_TEST_THREADS];
static int active_test_count = 0;

/* Test function declarations */
extern void deadlock_test_entry(void *p1, void *p2, void *p3);
extern void buffer_overflow_test_entry(void *p1, void *p2, void *p3);
extern void memory_leak_test_entry(void *p1, void *p2, void *p3);
extern void timing_violation_test_entry(void *p1, void *p2, void *p3);

/* Stack overflow test (internal) */
__attribute__((noinline)) void recursive_overflow(int depth) {
    volatile char buffer[1024];  /* 1KB per call */
    
    for(int i = 0; i < 1024; i++) {
        buffer[i] = (char)(depth % 256);
    }
    
    LOG_INF("Stack overflow test - recursion depth: %d", depth);
    k_sleep(K_MSEC(100));
    
    recursive_overflow(depth + 1);
}

void stack_overflow_test_entry(void *p1, void *p2, void *p3) {
    ARG_UNUSED(p1);
    ARG_UNUSED(p2);
    ARG_UNUSED(p3);
    
    LOG_INF("Starting stack overflow test in 3 seconds...");
    k_sleep(K_SECONDS(3));
    
    LOG_WRN("⚠️  Triggering stack overflow fault...");
    ft_report_fault(FT_STACK_OVERFLOW_FAULT, FT_SEVERITY_HIGH);
    
    recursive_overflow(0);
}

/* Enhanced fault handler with multi-fault support */
void k_sys_fatal_error_handler(unsigned int reason, const struct arch_esf *esf)
{
    LOG_ERR("Fatal error detected: reason %d", reason);
    
    switch (reason) {
        case K_ERR_STACK_CHK_FAIL:
            LOG_ERR("Stack overflow in thread %p", k_current_get());
            ft_report_fault(FT_STACK_OVERFLOW_FAULT, FT_SEVERITY_CRITICAL);
            LOG_INF("Attempting graceful recovery...");
            k_thread_abort(k_current_get());
            return;
            
        case K_ERR_KERNEL_OOPS:
            LOG_ERR("Kernel oops in thread %p", k_current_get());
            ft_report_fault(FT_ASSERT_FAULT, FT_SEVERITY_CRITICAL);
            break;
            
        case K_ERR_CPU_EXCEPTION:
            LOG_ERR("CPU exception in thread %p", k_current_get());
            ft_report_fault(FT_UNKNOWN_FAULT, FT_SEVERITY_CRITICAL);
            break;
            
        default:
            LOG_ERR("Unknown fatal error: %d", reason);
            ft_report_fault(FT_UNKNOWN_FAULT, FT_SEVERITY_CRITICAL);
            break;
    }
    
    /* For other critical faults, halt the system */
    LOG_ERR("System halting due to unrecoverable fault");
    k_fatal_halt(reason);
}

/* Test orchestration */
static void start_test(const char* test_name, k_thread_entry_t entry_func) {
    if (active_test_count >= MAX_TEST_THREADS) {
        LOG_ERR("Too many active tests!");
        return;
    }
    
    LOG_INF("🔧 Starting %s", test_name);
    
    k_thread_create(&test_threads[active_test_count], 
                   test_stacks[active_test_count], 
                   TEST_THREAD_STACK_SIZE,
                   entry_func, NULL, NULL, NULL,
                   K_PRIO_COOP(7), 0, K_NO_WAIT);
                   
    k_thread_name_set(&test_threads[active_test_count], test_name);
    active_test_count++;
}

static void monitor_system_health(void) {
    int cycle = 0;
    int recovered_tests = 0;
    
    while (1) {
        LOG_INF("📊 System health check - cycle %d", cycle++);
        
        /* Check for recovered/terminated test threads */
        for (int i = 0; i < active_test_count; i++) {
            if (k_thread_join(&test_threads[i], K_NO_WAIT) == 0) {
                LOG_INF("✅ Test thread %d completed/recovered", i);
                recovered_tests++;
            }
        }
        
        /* System metrics */
        LOG_INF("📈 Active threads: %d, Recovered: %d", 
               active_test_count - recovered_tests, recovered_tests);
               
        /* Check fault tolerance system health */
        ft_check_stack_usage(); // This reports system-wide stack health
        
        k_sleep(K_SECONDS(5));
        
        /* Exit condition */
        if (cycle > 20 || recovered_tests >= active_test_count) {
            LOG_INF("🏁 Test suite completed - %d tests recovered successfully", 
                   recovered_tests);
            break;
        }
    }
}

void main(void) {
    LOG_INF("=== 🚀 Comprehensive Fault Tolerance Test Suite ===");
    LOG_INF("Framework will automatically handle detected faults");
    
    /* Wait for fault tolerance system initialization */
    k_sleep(K_SECONDS(2));
    
    /* Display enabled fault detection modules */
    LOG_INF("🔍 Enabled Fault Detection Modules:");
    
    if (RUN_STACK_OVERFLOW_TEST) {
        LOG_INF("  ✓ Stack Overflow Protection");
    }
    if (RUN_DEADLOCK_TEST) {
        LOG_INF("  ✓ Deadlock Detection");  
    }
    if (RUN_BUFFER_OVERFLOW_TEST) {
        LOG_INF("  ✓ Buffer Overflow Protection");
    }
    if (RUN_MEMORY_LEAK_TEST) {
        LOG_INF("  ✓ Memory Leak Detection");
    }
    if (RUN_TIMING_VIOLATION_TEST) {
        LOG_INF("  ✓ Timing Violation Detection");
    }
    
    LOG_INF("🔥 Starting fault injection tests...");
    k_sleep(K_SECONDS(1));
    
    /* Launch test threads based on configuration */
    if (RUN_STACK_OVERFLOW_TEST) {
        start_test("stack_overflow", stack_overflow_test_entry);
        k_sleep(K_SECONDS(2)); /* Stagger test starts */
    }
    
    if (RUN_DEADLOCK_TEST) {
        start_test("deadlock", deadlock_test_entry);
        k_sleep(K_SECONDS(2));
    }
    
    if (RUN_BUFFER_OVERFLOW_TEST) {
        start_test("buffer_overflow", buffer_overflow_test_entry);
        k_sleep(K_SECONDS(2));
    }
    
    if (RUN_MEMORY_LEAK_TEST) {
        start_test("memory_leak", memory_leak_test_entry);
        k_sleep(K_SECONDS(2));
    }
    
    if (RUN_TIMING_VIOLATION_TEST) {
        start_test("timing_violation", timing_violation_test_entry);
        k_sleep(K_SECONDS(2));
    }
    
    /* Monitor system health and recovery */
    LOG_INF("🏥 Starting system health monitoring...");
    monitor_system_health();
    
    LOG_INF("=== 🎯 Comprehensive Test Summary ===");
    LOG_INF("All configured fault detection modules tested");
    LOG_INF("Fault tolerance framework operational");
    
    /* Keep system running to observe long-term stability */
    while (1) {
        LOG_INF("💪 System running stably post-recovery");
        k_sleep(K_SECONDS(10));
    }
}
```

## src/buffer_overflow_test.c
```c
#include <zephyr/kernel.h>
#include <zephyr/logging/log.h>
#include <zephyr/fault_tolerance.h>
#include <string.h>

LOG_MODULE_REGISTER(buffer_overflow_test, LOG_LEVEL_INF);

/* Buffer overflow detection using canaries */
#define BUFFER_SIZE 64
#define CANARY_PATTERN 0xDEADBEEF

struct protected_buffer {
    uint32_t pre_canary;
    char data[BUFFER_SIZE];
    uint32_t post_canary;
};

static bool check_buffer_integrity(struct protected_buffer *buf) {
    if (buf->pre_canary != CANARY_PATTERN || buf->post_canary != CANARY_PATTERN) {
        return false;
    }
    return true;
}

static void init_protected_buffer(struct protected_buffer *buf) {
    buf->pre_canary = CANARY_PATTERN;
    buf->post_canary = CANARY_PATTERN;
    memset(buf->data, 0, BUFFER_SIZE);
}

/* Simulate common buffer overflow scenarios */
static void test_strcpy_overflow(void) {
    struct protected_buffer buf;
    init_protected_buffer(&buf);
    
    /* Dangerous: Copy string longer than buffer */
    const char *long_string = "This is a very long string that will definitely overflow the 64-byte buffer and corrupt memory beyond it causing serious security vulnerabilities";
    
    LOG_INF("📝 Testing strcpy overflow (unsafe string copy)");
    LOG_INF("   Buffer size: %d bytes", BUFFER_SIZE);
    LOG_INF("   String length: %d bytes", strlen(long_string));
    
    /* This will overflow! */
    strcpy(buf.data, long_string);
    
    /* Check for corruption */
    if (!check_buffer_integrity(&buf)) {
        LOG_ERR("🚨 BUFFER OVERFLOW DETECTED! Canaries corrupted");
        LOG_ERR("   Pre-canary: 0x%08X (expected: 0x%08X)", 
               buf.pre_canary, CANARY_PATTERN);
        LOG_ERR("   Post-canary: 0x%08X (expected: 0x%08X)", 
               buf.post_canary, CANARY_PATTERN);
        
        ft_report_fault(FT_BUFFER_OVERFLOW_FAULT, FT_SEVERITY_HIGH);
    } else {
        LOG_INF("✅ Buffer integrity maintained");
    }
}

static void test_array_bounds_overflow(void) {
    struct protected_buffer buf;
    init_protected_buffer(&buf);
    
    LOG_INF("📝 Testing array bounds overflow");
    
    /* Write beyond array bounds */
    for (int i = 0; i <= BUFFER_SIZE + 10; i++) {
        buf.data[i] = (char)(i % 256);
        
        /* Check integrity periodically */
        if (i > BUFFER_SIZE && !check_buffer_integrity(&buf)) {
            LOG_ERR("🚨 BUFFER OVERFLOW DETECTED at index %d!", i);
            ft_report_fault(FT_BUFFER_OVERFLOW_FAULT, FT_SEVERITY_HIGH);
            break;
        }
    }
}

static void test_stack_buffer_overflow(void) {
    /* Stack buffer without protection (more dangerous) */
    char stack_buffer[32];
    
    LOG_INF("📝 Testing stack buffer overflow (no canaries)");
    
    /* This will corrupt the stack */
    const char *overflow_data = "This string is much too long for the 32 byte stack buffer and will corrupt the stack frame";
    
    LOG_WRN("⚠️  Performing dangerous stack overflow...");
    strcpy(stack_buffer, overflow_data);
    
    /* If we reach here, stack wasn't corrupted enough to crash immediately */
    LOG_INF("Stack buffer contains: %.30s...", stack_buffer);
    
    /* Report the fault */
    ft_report_fault(FT_BUFFER_OVERFLOW_FAULT, FT_SEVERITY_CRITICAL);
}

void buffer_overflow_test_entry(void *p1, void *p2, void *p3) {
    ARG_UNUSED(p1);
    ARG_UNUSED(p2);
    ARG_UNUSED(p3);
    
    LOG_INF("🛡️  Starting buffer overflow detection test");
    
    k_sleep(K_SECONDS(1));
    
    /* Test 1: String copy overflow with canary protection */
    test_strcpy_overflow();
    k_sleep(K_MSEC(500));
    
    /* Test 2: Array bounds overflow */
    test_array_bounds_overflow();
    k_sleep(K_MSEC(500));
    
    /* Test 3: Stack buffer overflow (most dangerous) */
    test_stack_buffer_overflow();
    
    LOG_INF("✅ Buffer overflow test completed");
    LOG_INF("🛡️  Buffer overflow detection test finished");
}
```

## src/deadlock_test.c
```c
#include <zephyr/kernel.h>
#include <zephyr/logging/log.h>
#include <zephyr/fault_tolerance.h>

LOG_MODULE_REGISTER(deadlock_test, LOG_LEVEL_INF);

/* Shared resources for deadlock scenario */
static struct k_mutex mutex_a;
static struct k_mutex mutex_b;
static bool deadlock_detected = false;

/* Thread stacks for deadlock scenario */
#define DEADLOCK_THREAD_STACK_SIZE 1024
K_THREAD_STACK_DEFINE(deadlock_thread1_stack, DEADLOCK_THREAD_STACK_SIZE);
K_THREAD_STACK_DEFINE(deadlock_thread2_stack, DEADLOCK_THREAD_STACK_SIZE);

static struct k_thread deadlock_thread1;
static struct k_thread deadlock_thread2;

/* Deadlock detection timer */
static struct k_timer deadlock_timer;

static void deadlock_timer_handler(struct k_timer *timer) {
    ARG_UNUSED(timer);
    
    if (!deadlock_detected) {
        LOG_ERR("🔒 DEADLOCK DETECTED! Threads blocked for too long");
        deadlock_detected = true;
        
        /* Report deadlock fault */
        ft_report_fault(FT_DEADLOCK_FAULT, FT_SEVERITY_HIGH);
        
        /* Recovery: Abort both threads to break deadlock */
        LOG_INF("🔧 Recovery: Terminating deadlocked threads");
        k_thread_abort(&deadlock_thread1);
        k_thread_abort(&deadlock_thread2);
        
        LOG_INF("✅ Deadlock recovery completed");
    }
}

static void deadlock_thread1_entry(void *p1, void *p2, void *p3) {
    ARG_UNUSED(p1);
    ARG_UNUSED(p2);
    ARG_UNUSED(p3);
    
    LOG_INF("Deadlock Thread 1: Starting");
    
    /* Acquire mutex A first */
    LOG_INF("Deadlock Thread 1: Acquiring mutex A");
    k_mutex_lock(&mutex_a, K_FOREVER);
    LOG_INF("Deadlock Thread 1: Got mutex A");
    
    /* Small delay to increase chance of deadlock */
    k_sleep(K_MSEC(100));
    
    /* Try to acquire mutex B (will block if thread 2 has it) */
    LOG_INF("Deadlock Thread 1: Trying to acquire mutex B");
    k_mutex_lock(&mutex_b, K_FOREVER);
    LOG_INF("Deadlock Thread 1: Got mutex B - NO DEADLOCK");
    
    /* This should not be reached in our deadlock scenario */
    k_mutex_unlock(&mutex_b);
    k_mutex_unlock(&mutex_a);
    LOG_INF("Deadlock Thread 1: Released all mutexes");
}

static void deadlock_thread2_entry(void *p1, void *p2, void *p3) {
    ARG_UNUSED(p1);
    ARG_UNUSED(p2);
    ARG_UNUSED(p3);
    
    LOG_INF("Deadlock Thread 2: Starting");
    
    /* Acquire mutex B first */
    LOG_INF("Deadlock Thread 2: Acquiring mutex B");
    k_mutex_lock(&mutex_b, K_FOREVER);
    LOG_INF("Deadlock Thread 2: Got mutex B");
    
    /* Small delay to increase chance of deadlock */
    k_sleep(K_MSEC(100));
    
    /* Try to acquire mutex A (will block if thread 1 has it) */
    LOG_INF("Deadlock Thread 2: Trying to acquire mutex A");
    k_mutex_lock(&mutex_a, K_FOREVER);
    LOG_INF("Deadlock Thread 2: Got mutex A - NO DEADLOCK");
    
    /* This should not be reached in our deadlock scenario */
    k_mutex_unlock(&mutex_a);
    k_mutex_unlock(&mutex_b);
    LOG_INF("Deadlock Thread 2: Released all mutexes");
}

void deadlock_test_entry(void *p1, void *p2, void *p3) {
    ARG_UNUSED(p1);
    ARG_UNUSED(p2);
    ARG_UNUSED(p3);
    
    LOG_INF("🔒 Starting deadlock detection test");
    
    /* Initialize mutexes */
    k_mutex_init(&mutex_a);
    k_mutex_init(&mutex_b);
    
    /* Initialize deadlock detection timer */
    k_timer_init(&deadlock_timer, deadlock_timer_handler, NULL);
    
    LOG_INF("📝 Scenario: Classic AB-BA deadlock pattern");
    LOG_INF("   Thread 1: Lock A → Lock B");
    LOG_INF("   Thread 2: Lock B → Lock A");
    
    /* Start deadlock detection timer */
    k_timer_start(&deadlock_timer, K_MSEC(CONFIG_FT_DEADLOCK_TIMEOUT_MS), K_NO_WAIT);
    LOG_INF("⏰ Deadlock timer started (%d ms timeout)", CONFIG_FT_DEADLOCK_TIMEOUT_MS);
    
    /* Create the two threads that will deadlock */
    k_thread_create(&deadlock_thread1, deadlock_thread1_stack, 
                   DEADLOCK_THREAD_STACK_SIZE,
                   deadlock_thread1_entry, NULL, NULL, NULL,
                   K_PRIO_COOP(8), 0, K_NO_WAIT);
    k_thread_name_set(&deadlock_thread1, "deadlock_t1");
    
    k_thread_create(&deadlock_thread2, deadlock_thread2_stack, 
                   DEADLOCK_THREAD_STACK_SIZE,
                   deadlock_thread2_entry, NULL, NULL, NULL,
                   K_PRIO_COOP(8), 0, K_NO_WAIT);
    k_thread_name_set(&deadlock_thread2, "deadlock_t2");
    
    /* Wait for deadlock detection or completion */
    int timeout_cycles = 0;
    while (!deadlock_detected && timeout_cycles < 20) {
        k_sleep(K_MSEC(500));
        timeout_cycles++;
        
        /* Check if threads completed normally (unlikely) */
        if (k_thread_join(&deadlock_thread1, K_NO_WAIT) == 0 &&
            k_thread_join(&deadlock_thread2, K_NO_WAIT) == 0) {
            LOG_INF("🤔 Threads completed without deadlock - unexpected!");
            break;
        }
    }
    
    /* Stop the timer */
    k_timer_stop(&deadlock_timer);
    
    if (deadlock_detected) {
        LOG_INF("✅ Deadlock test completed - fault detected and recovered");
    } else {
        LOG_WRN("⚠️  Deadlock test timed out without detection");
    }
    
    LOG_INF("🔒 Deadlock test finished");
}
```

## src/memory_leak_test.c
```c
#include <zephyr/kernel.h>
#include <zephyr/logging/log.h>
#include <zephyr/fault_tolerance.h>
#include <stdlib.h>

LOG_MODULE_REGISTER(memory_leak_test, LOG_LEVEL_INF);

/* Memory tracking structures */
struct allocation_record {
    void *ptr;
    size_t size;
    bool freed;
    int64_t timestamp;
};

#define MAX_TRACKED_ALLOCATIONS 50
static struct allocation_record allocations[MAX_TRACKED_ALLOCATIONS];
static int allocation_count = 0;
static size_t total_allocated = 0;
static size_t total_freed = 0;

static void track_allocation(void *ptr, size_t size) {
    if (allocation_count < MAX_TRACKED_ALLOCATIONS && ptr != NULL) {
        allocations[allocation_count].ptr = ptr;
        allocations[allocation_count].size = size;
        allocations[allocation_count].freed = false;
        allocations[allocation_count].timestamp = k_uptime_get();
        allocation_count++;
        total_allocated += size;
    }
}

static void track_deallocation(void *ptr) {
    for (int i = 0; i < allocation_count; i++) {
        if (allocations[i].ptr == ptr && !allocations[i].freed) {
            allocations[i].freed = true;
            total_freed += allocations[i].size;
            break;
        }
    }
}

static size_t get_leaked_memory(void) {
    return total_allocated - total_freed;
}

static void report_memory_status(void) {
    size_t leaked = get_leaked_memory();
    
    LOG_INF("📊 Memory Status:");
    LOG_INF("   Total allocated: %zu bytes", total_allocated);
    LOG_INF("   Total freed: %zu bytes", total_freed);
    LOG_INF("   Leaked memory: %zu bytes", leaked);
    
    if (leaked > CONFIG_FT_MEMORY_LEAK_THRESHOLD) {
        LOG_ERR("🚨 MEMORY LEAK DETECTED! Leaked: %zu bytes", leaked);
        ft_report_fault(FT_MEMORY_LEAK_FAULT, FT_SEVERITY_MEDIUM);
    }
}

/* Simulate common memory leak patterns */
static void test_simple_leak(void) {
    LOG_INF("📝 Testing simple memory leak");
    
    /* Allocate without freeing */
    for (int i = 0; i < 10; i++) {
        void *ptr = k_malloc(64);
        track_allocation(ptr, 64);
        LOG_INF("   Allocated 64 bytes at %p (leak #%d)", ptr, i + 1);
    }
    
    report_memory_status();
}

static void test_partial_cleanup(void) {
    LOG_INF("📝 Testing partial cleanup pattern");
    
    void *ptrs[10];
    
    /* Allocate multiple blocks */
    for (int i = 0; i < 10; i++) {
        ptrs[i] = k_malloc(32);
        track_allocation(ptrs[i], 32);
    }
    
    /* Free only some of them (common bug pattern) */
    for (int i = 0; i < 5; i++) {
        track_deallocation(ptrs[i]);
        k_free(ptrs[i]);
        LOG_INF("   Freed block %d", i);
    }
    
    LOG_WRN("   Intentionally not freeing blocks 5-9 (simulating leak)");
    report_memory_status();
}

static void test_loop_leak(void) {
    LOG_INF("📝 Testing loop-based memory leak");
    
    /* Common pattern: allocate in loop without proper cleanup */
    for (int iteration = 0; iteration < 5; iteration++) {
        LOG_INF("   Loop iteration %d", iteration);
        
        /* Allocate temporary buffers */
        for (int i = 0; i < 3; i++) {
            void *temp = k_malloc(128);
            track_allocation(temp, 128);
            
            /* Simulate work with the buffer */
            k_sleep(K_MSEC(10));
            
            /* "Forget" to free one buffer per iteration */
            if (i != 2) {
                track_deallocation(temp);
                k_free(temp);
            }
        }
    }
    
    report_memory_status();
}

static void test_double_free_protection(void) {
    LOG_INF("📝 Testing double-free protection");
    
    void *ptr = k_malloc(256);
    track_allocation(ptr, 256);
    LOG_INF("   Allocated 256 bytes at %p", ptr);
    
    /* First free (legitimate) */
    track_deallocation(ptr);
    k_free(ptr);
    LOG_INF("   First free successful");
    
    /* Attempt double-free (bug) */
    LOG_WRN("   Attempting double-free (should be caught)...");
    /* Note: k_free might not detect double-free, but we can track it */
    
    /* Check if this was already freed */
    bool already_freed = false;
    for (int i = 0; i < allocation_count; i++) {
        if (allocations[i].ptr == ptr && allocations[i].freed) {
            already_freed = true;
            break;
        }
    }
    
    if (already_freed) {
        LOG_ERR("🚨 DOUBLE-FREE DETECTED for pointer %p!", ptr);
        ft_report_fault(FT_BUFFER_OVERFLOW_FAULT, FT_SEVERITY_HIGH);
    }
}

void memory_leak_test_entry(void *p1, void *p2, void *p3) {
    ARG_UNUSED(p1);
    ARG_UNUSED(p2);
    ARG_UNUSED(p3);
    
    LOG_INF("🧠 Starting memory leak detection test");
    LOG_INF("   Leak threshold: %d bytes", CONFIG_FT_MEMORY_LEAK_THRESHOLD);
    
    k_sleep(K_SECONDS(1));
    
    /* Test 1: Simple memory leaks */
    test_simple_leak();
    k_sleep(K_MSEC(500));
    
    /* Test 2: Partial cleanup (common in error handling) */
    test_partial_cleanup();
    k_sleep(K_MSEC(500));
    
    /* Test 3: Loop-based leaks */
    test_loop_leak();
    k_sleep(K_MSEC(500));
    
    /* Test 4: Double-free protection */
    test_double_free_protection();
    
    /* Final memory report */
    LOG_INF("🔍 Final memory leak analysis:");
    report_memory_status();
    
    /* List unfreed allocations */
    int leak_count = 0;
    for (int i = 0; i < allocation_count; i++) {
        if (!allocations[i].freed) {
            LOG_WRN("   LEAK: %zu bytes at %p (allocated at %lld ms)", 
                   allocations[i].size, allocations[i].ptr, 
                   allocations[i].timestamp);
            leak_count++;
        }
    }
    
    LOG_INF("🧠 Memory leak test completed - %d leaks detected", leak_count);
}
```

## src/timing_violation_test.c
```c
#include <zephyr/kernel.h>
#include <zephyr/logging/log.h>
#include <zephyr/fault_tolerance.h>

LOG_MODULE_REGISTER(timing_violation_test, LOG_LEVEL_INF);

/* Timing constraint structures */
struct timing_constraint {
    const char *task_name;
    int64_t deadline_ms;
    int64_t start_time;
    bool active;
};

#define MAX_TIMING_TASKS 5
static struct timing_constraint timing_tasks[MAX_TIMING_TASKS];
static int task_count = 0;

static void start_timing_task(const char *name, int64_t deadline_ms) {
    if (task_count < MAX_TIMING_TASKS) {
        timing_tasks[task_count].task_name = name;
        timing_tasks[task_count].deadline_ms = deadline_ms;
        timing_tasks[task_count].start_time = k_uptime_get();
        timing_tasks[task_count].active = true;
        task_count++;
        
        LOG_INF("⏱️  Started timing task '%s' with %lld ms deadline", 
               name, deadline_ms);
    }
}

static void finish_timing_task(const char *name) {
    int64_t current_time = k_uptime_get();
    
    for (int i = 0; i < task_count; i++) {
        if (timing_tasks[i].active && 
            strcmp(timing_tasks[i].task_name, name) == 0) {
            
            int64_t elapsed = current_time - timing_tasks[i].start_time;
            timing_tasks[i].active = false;
            
            LOG_INF("⏱️  Task '%s' completed in %lld ms", name, elapsed);
            
            if (elapsed > timing_tasks[i].deadline_ms) {
                LOG_ERR("🚨 TIMING VIOLATION! Task '%s' exceeded deadline", name);
                LOG_ERR("   Deadline: %lld ms, Actual: %lld ms, Overrun: %lld ms",
                       timing_tasks[i].deadline_ms, elapsed, 
                       elapsed - timing_tasks[i].deadline_ms);
                
                ft_report_fault(FT_TIMING_VIOLATION_FAULT, FT_SEVERITY_MEDIUM);
            } else {
                LOG_INF("✅ Task '%s' met deadline (%lld ms remaining)", 
                       name, timing_tasks[i].deadline_ms - elapsed);
            }
            break;
        }
    }
}

/* Timing violation test scenarios */
static void test_simple_deadline_miss(void) {
    LOG_INF("📝 Testing simple deadline miss");
    
    start_timing_task("quick_task", 100);  /* 100ms deadline */
    
    /* Simulate work that takes too long */
    LOG_INF("   Performing work that should take 50ms but will take 150ms...");
    k_sleep(K_MSEC(150));  /* Intentionally exceed deadline */
    
    finish_timing_task("quick_task");
}

static void test_periodic_task_overrun(void) {
    LOG_INF("📝 Testing periodic task overrun");
    
    const int period_ms = 200;
    const int work_time_ms = 250;  /* Longer than period */
    
    for (int cycle = 0; cycle < 3; cycle++) {
        char task_name[32];
        snprintf(task_name, sizeof(task_name), "periodic_cycle_%d", cycle);
        
        start_timing_task(task_name, period_ms);
        
        LOG_INF("   Cycle %d: Work time %dms exceeds period %dms", 
               cycle, work_time_ms, period_ms);
        k_sleep(K_MSEC(work_time_ms));
        
        finish_timing_task(task_name);
    }
}

static void test_interrupt_latency_violation(void) {
    LOG_INF("📝 Testing interrupt response latency");
    
    /* Simulate high-priority interrupt response requirement */
    start_timing_task("interrupt_response", 5);  /* Very tight 5ms deadline */
    
    LOG_INF("   Simulating interrupt handler with 5ms deadline...");
    
    /* Simulate some critical interrupt processing */
    volatile int computation = 0;
    for (int i = 0; i < 100000; i++) {
        computation += i % 7;  /* Some computation */
    }
    
    /* Add intentional delay to violate timing */
    k_sleep(K_MSEC(10));  /* This will cause violation */
    
    finish_timing_task("interrupt_response");
}

static void test_cascading_delays(void) {
    LOG_INF("📝 Testing cascading delay effects");
    
    /* Start multiple dependent tasks */
    start_timing_task("task_a", 100);
    start_timing_task("task_b", 200);
    start_timing_task("task_c", 300);
    
    /* Task A takes too long, affecting others */
    LOG_INF("   Task A taking 120ms (deadline 100ms)...");
    k_sleep(K_MSEC(120));
    finish_timing_task("task_a");
    
    /* Task B now has less time */
    LOG_INF("   Task B execution (affected by Task A delay)...");
    k_sleep(K_MSEC(100));
    finish_timing_task("task_b");
    
    /* Task C gets remaining time */
    LOG_INF("   Task C execution (further affected)...");
    k_sleep(K_MSEC(80));
    finish_timing_task("task_c");
}

static void test_watchdog_timeout(void) {
    LOG_INF("📝 Testing watchdog timeout scenario");
    
    start_timing_task("watchdog_task", 500);  /* 500ms watchdog timeout */
    
    LOG_INF("   Simulating task that should pet watchdog every 400ms...");
    
    /* First pet - OK */
    k_sleep(K_MSEC(300));
    LOG_INF("   Watchdog pet at 300ms - OK");
    
    /* Second interval - will exceed watchdog timeout */
    k_sleep(K_MSEC(400));  /* Total: 700ms, exceeds 500ms timeout */
    LOG_ERR("   Watchdog timeout would have occurred!");
    
    finish_timing_task("watchdog_task");
}

void timing_violation_test_entry(void *p1, void *p2, void *p3) {
    ARG_UNUSED(p1);
    ARG_UNUSED(p2);
    ARG_UNUSED(p3);
    
    LOG_INF("⏰ Starting timing violation detection test");
    LOG_INF("   Default timing threshold: %d ms", CONFIG_FT_TIMING_VIOLATION_THRESHOLD_MS);
    
    k_sleep(K_SECONDS(1));
    
    /* Test 1: Simple deadline miss */
    test_simple_deadline_miss();
    k_sleep(K_MSEC(500));
    
    /* Test 2: Periodic task overrun */
    test_periodic_task_overrun();
    k_sleep(K_MSEC(500));
    
    /* Test 3: Interrupt latency violation */
    test_interrupt_latency_violation();
    k_sleep(K_MSEC(500));
    
    /* Test 4: Cascading delays */
    test_cascading_delays();
    k_sleep(K_MSEC(500));
    
    /* Test 5: Watchdog timeout */
    test_watchdog_timeout();
    
    /* Summary */
    LOG_INF("📊 Timing Violation Test Summary:");
    int violations = 0;
    for (int i = 0; i < task_count; i++) {
        if (!timing_tasks[i].active) {
            int64_t elapsed = k_uptime_get() - timing_tasks[i].start_time;
            if (elapsed > timing_tasks[i].deadline_ms) {
                violations++;
            }
        }
    }
    
    LOG_INF("   Total tasks: %d", task_count);
    LOG_INF("   Timing violations: %d", violations);
    
    LOG_INF("⏰ Timing violation test completed");
}
```
