## CMakeLists.txt
```
#
# Copyright (c) 2025 Jack Ostapeic
#
# Modular Fault Tolerance Integration Test Application
#

cmake_minimum_required(VERSION 3.20.0)
find_package(Zephyr REQUIRED HINTS $ENV{ZEPHYR_BASE})
project(ft_modular_integration)

target_sources(app PRIVATE src/main.c)

# Additional sources for comprehensive testing
target_sources_ifdef(CONFIG_FT_ENABLE_STACK_OVERFLOW_PROTECTION app PRIVATE src/stack_overflow_test.c)
target_sources_ifdef(CONFIG_FT_ENABLE_BUFFER_OVERFLOW_PROTECTION app PRIVATE src/buffer_overflow_test.c)
target_sources_ifdef(CONFIG_FT_ENABLE_DEADLOCK_DETECTION app PRIVATE src/deadlock_test.c)
target_sources_ifdef(CONFIG_FT_ENABLE_RACE_CONDITION_DETECTION app PRIVATE src/race_condition_test.c)
```

## prj.conf
```kconfig
# Modular Fault Tolerance Integration Configuration

# Enable fault tolerance framework
CONFIG_FAULT_TOLERANCE=y

# Enable all fault tolerance modules for comprehensive testing
CONFIG_FT_ENABLE_STACK_OVERFLOW_PROTECTION=y
CONFIG_FT_STACK_OVERFLOW_THRESHOLD_PERCENT=80
CONFIG_FT_STACK_OVERFLOW_CHECK_INTERVAL_MS=500

CONFIG_FT_ENABLE_BUFFER_OVERFLOW_PROTECTION=y
CONFIG_FT_BUFFER_OVERFLOW_CANARY_VALUE=0xDEADBEEF
CONFIG_FT_BUFFER_OVERFLOW_CHECK_INTERVAL_MS=250

CONFIG_FT_ENABLE_DEADLOCK_DETECTION=y
CONFIG_FT_DEADLOCK_DETECTION_TIMEOUT_MS=5000
CONFIG_FT_DEADLOCK_MONITOR_INTERVAL_MS=1000

CONFIG_FT_ENABLE_RACE_CONDITION_DETECTION=y
CONFIG_FT_RACE_CONDITION_DETECTION_WINDOW_US=1000
CONFIG_FT_RACE_CONDITION_ACCESS_HISTORY_SIZE=64

# Enable core fault tolerance modules (disable problematic ones for now)
CONFIG_FT_ENABLE_THREAD_RECOVERY=y
# CONFIG_FT_ENABLE_SYSTEM_MONITOR=y  # Disabled - requires WATCHDOG
# CONFIG_FT_ENABLE_FAULT_LOGGING=y   # Disabled - requires FLASH and SETTINGS

# System configuration for testing
CONFIG_LOG=y
CONFIG_LOG_DEFAULT_LEVEL=3
CONFIG_PRINTK=y
CONFIG_ASSERT=y

# Thread and timing configuration
CONFIG_MULTITHREADING=y
CONFIG_NUM_PREEMPT_PRIORITIES=16
CONFIG_MAIN_STACK_SIZE=4096
CONFIG_SYSTEM_WORKQUEUE_STACK_SIZE=4096

# Memory configuration
CONFIG_HEAP_MEM_POOL_SIZE=32768
```

## src/main.c
```c
/*
 * Copyright (c) 2025 Jack Ostapeic
 *
 * SPDX-License-Identifier: Apache-2.0
 *
 * Modular Fault Tolerance Integration Test
 * 
 * This application demonstrates the modular fault tolerance framework
 * with runtime configuration based on Kconfig selections.
 */

#include <zephyr/kernel.h>
#include <zephyr/logging/log.h>
#include <zephyr/fault_tolerance/ft_core.h>

/* Conditionally include module headers based on configuration */
#ifdef CONFIG_FT_ENABLE_STACK_OVERFLOW_PROTECTION
#include <zephyr/fault_tolerance/ft_stack_overflow.h>
#endif

#ifdef CONFIG_FT_ENABLE_BUFFER_OVERFLOW_PROTECTION
#include <zephyr/fault_tolerance/ft_buffer_overflow.h>
#endif

#ifdef CONFIG_FT_ENABLE_DEADLOCK_DETECTION
#include <zephyr/fault_tolerance/ft_deadlock.h>
#endif

#ifdef CONFIG_FT_ENABLE_RACE_CONDITION_DETECTION
#include <zephyr/fault_tolerance/ft_race_condition.h>
#endif

LOG_MODULE_REGISTER(ft_modular_test, LOG_LEVEL_INF);

/* External test function declarations */
#ifdef CONFIG_FT_ENABLE_STACK_OVERFLOW_PROTECTION
int stack_overflow_test(void);
#endif

#ifdef CONFIG_FT_ENABLE_BUFFER_OVERFLOW_PROTECTION
int buffer_overflow_test(void);
#endif

#ifdef CONFIG_FT_ENABLE_DEADLOCK_DETECTION
int deadlock_test(void);
#endif

#ifdef CONFIG_FT_ENABLE_RACE_CONDITION_DETECTION
int race_condition_test(void);
#endif

/* Test configuration display */
static void display_test_configuration(void)
{
    LOG_INF("=== Modular Fault Tolerance Integration Test ===");
    LOG_INF("Enabled modules:");

#ifdef CONFIG_FT_ENABLE_STACK_OVERFLOW_PROTECTION
    LOG_INF("  ✓ Stack Overflow Protection");
#else
    LOG_INF("  ✗ Stack Overflow Protection - DISABLED");
#endif

#ifdef CONFIG_FT_ENABLE_BUFFER_OVERFLOW_PROTECTION
    LOG_INF("  ✓ Buffer Overflow Protection");
#else
    LOG_INF("  ✗ Buffer Overflow Protection - DISABLED");
#endif

#ifdef CONFIG_FT_ENABLE_DEADLOCK_DETECTION
    LOG_INF("  ✓ Deadlock Detection");
#else
    LOG_INF("  ✗ Deadlock Detection - DISABLED");
#endif

#ifdef CONFIG_FT_ENABLE_RACE_CONDITION_DETECTION
    LOG_INF("  ✓ Race Condition Detection");
#else
    LOG_INF("  ✗ Race Condition Detection - DISABLED");
#endif

    LOG_INF("================================================");
}

/* Initialize all enabled fault tolerance modules */
static int initialize_modules(void)
{
    int ret = 0;
    
    LOG_INF("Initializing enabled fault tolerance modules...");

#ifdef CONFIG_FT_ENABLE_STACK_OVERFLOW_PROTECTION
    ret = ft_stack_overflow_init();
    if (ret < 0) {
        LOG_ERR("Failed to initialize stack overflow protection: %d", ret);
        return ret;
    }
    LOG_INF("Stack overflow protection initialized");
#endif

#ifdef CONFIG_FT_ENABLE_BUFFER_OVERFLOW_PROTECTION
    ret = ft_buffer_overflow_init();
    if (ret < 0) {
        LOG_ERR("Failed to initialize buffer overflow protection: %d", ret);
        return ret;
    }
    LOG_INF("Buffer overflow protection initialized");
#endif

#ifdef CONFIG_FT_ENABLE_DEADLOCK_DETECTION
    ret = ft_deadlock_init();
    if (ret < 0) {
        LOG_ERR("Failed to initialize deadlock detection: %d", ret);
        return ret;
    }
    LOG_INF("Deadlock detection initialized");
#endif

#ifdef CONFIG_FT_ENABLE_RACE_CONDITION_DETECTION
    ret = ft_race_init();
    if (ret < 0) {
        LOG_ERR("Failed to initialize race condition detection: %d", ret);
        return ret;
    }
    LOG_INF("Race condition detection initialized");
#endif

    LOG_INF("All enabled modules initialized successfully");
    return 0;
}

/* Run tests for all enabled modules */
static void run_module_tests(void)
{
    LOG_INF("Running tests for enabled modules...");

#ifdef CONFIG_FT_ENABLE_STACK_OVERFLOW_PROTECTION
    LOG_INF("Running stack overflow protection test...");
    if (stack_overflow_test() == 0) {
        LOG_INF("Stack overflow test: PASSED");
    } else {
        LOG_ERR("Stack overflow test: FAILED");
    }
    k_sleep(K_MSEC(1000));
#endif

#ifdef CONFIG_FT_ENABLE_BUFFER_OVERFLOW_PROTECTION
    LOG_INF("Running buffer overflow protection test...");
    if (buffer_overflow_test() == 0) {
        LOG_INF("Buffer overflow test: PASSED");
    } else {
        LOG_ERR("Buffer overflow test: FAILED");
    }
    k_sleep(K_MSEC(1000));
#endif

#ifdef CONFIG_FT_ENABLE_DEADLOCK_DETECTION
    LOG_INF("Running deadlock detection test...");
    if (deadlock_test() == 0) {
        LOG_INF("Deadlock test: PASSED");
    } else {
        LOG_ERR("Deadlock test: FAILED");
    }
    k_sleep(K_MSEC(1000));
#endif

#ifdef CONFIG_FT_ENABLE_RACE_CONDITION_DETECTION
    LOG_INF("Running race condition detection test...");
    if (race_condition_test() == 0) {
        LOG_INF("Race condition test: PASSED");
    } else {
        LOG_ERR("Race condition test: FAILED");
    }
    k_sleep(K_MSEC(1000));
#endif

    LOG_INF("All enabled module tests completed");
}

/* Display statistics from all enabled modules */
static void display_module_statistics(void)
{
    LOG_INF("=== Module Statistics ===");

#ifdef CONFIG_FT_ENABLE_STACK_OVERFLOW_PROTECTION
    struct ft_stack_overflow_stats stack_stats;
    if (ft_stack_overflow_get_stats(&stack_stats) == 0) {
        LOG_INF("Stack Overflow Protection:");
        LOG_INF("  Threads monitored: %u", stack_stats.threads_monitored);
        LOG_INF("  Violations detected: %u", stack_stats.violations_detected);
        LOG_INF("  Threads suspended: %u", stack_stats.threads_suspended);
    }
#endif

#ifdef CONFIG_FT_ENABLE_BUFFER_OVERFLOW_PROTECTION
    struct ft_buffer_overflow_stats buffer_stats;
    if (ft_buffer_overflow_get_stats(&buffer_stats) == 0) {
        LOG_INF("Buffer Overflow Protection:");
        LOG_INF("  Buffers protected: %u", buffer_stats.buffers_protected);
        LOG_INF("  Violations detected: %u", buffer_stats.violations_detected);
        LOG_INF("  Repairs performed: %u", buffer_stats.repairs_performed);
    }
#endif

#ifdef CONFIG_FT_ENABLE_DEADLOCK_DETECTION
    struct ft_deadlock_stats deadlock_stats;
    if (ft_deadlock_get_stats(&deadlock_stats) == 0) {
        LOG_INF("Deadlock Detection:");
        LOG_INF("  Resources monitored: %u", deadlock_stats.resources_monitored);
        LOG_INF("  Deadlocks detected: %u", deadlock_stats.deadlocks_detected);
        LOG_INF("  Deadlocks resolved: %u", deadlock_stats.deadlocks_resolved);
    }
#endif

#ifdef CONFIG_FT_ENABLE_RACE_CONDITION_DETECTION
    struct ft_race_stats race_stats;
    if (ft_race_get_stats(&race_stats) == 0) {
        LOG_INF("Race Condition Detection:");
        LOG_INF("  Accesses monitored: %u", race_stats.total_accesses_monitored);
        LOG_INF("  Race conditions detected: %u", race_stats.race_conditions_detected);
        LOG_INF("  Race conditions prevented: %u", race_stats.race_conditions_prevented);
    }
#endif

    LOG_INF("========================");
}

/* Main application function */
int main(void)
{
    int ret;

    LOG_INF("Starting Modular Fault Tolerance Integration Test");
    
    /* Initialize fault tolerance framework */
    struct ft_config config = {0};
    ret = ft_init(&config);
    if (ret < 0) {
        LOG_ERR("Failed to initialize fault tolerance framework: %d", ret);
        return ret;
    }

    /* Display test configuration */
    display_test_configuration();
    
    /* Initialize all enabled modules */
    ret = initialize_modules();
    if (ret < 0) {
        LOG_ERR("Module initialization failed");
        return ret;
    }

    /* Let modules stabilize */
    k_sleep(K_MSEC(2000));

    /* Run tests for enabled modules */
    run_module_tests();

    /* Display final statistics */
    k_sleep(K_MSEC(1000));
    display_module_statistics();

    LOG_INF("Modular Fault Tolerance Integration Test completed");
    LOG_INF("System will continue running for monitoring...");

    /* Keep system running for continuous monitoring */
    while (1) {
        k_sleep(K_MSEC(10000));
        LOG_INF("System operational - fault tolerance active");
    }

    return 0;
}
```

## src/buffer_overflow_test.c
```c
/*
 * Copyright (c) 2025 Jack Ostapeic
 *
 * Buffer Overflow Protection Test Module
 */

#include <zephyr/kernel.h>
#include <zephyr/logging/log.h>
#include <zephyr/fault_tolerance/ft_buffer_overflow.h>
#include <string.h>

LOG_MODULE_REGISTER(buffer_overflow_test, LOG_LEVEL_INF);

/* Test the buffer overflow protection module */
int buffer_overflow_test(void)
{
    int ret;
    struct ft_buffer_overflow_stats stats;
    struct ft_protected_buffer *protected_buf;
    char test_data[] = "Hello, Fault Tolerance!";
    char read_buffer[64];

    LOG_INF("=== Buffer Overflow Protection Test ===");

    /* Create a protected buffer */
    protected_buf = ft_buffer_overflow_create_protected(32, "test_buffer");
    if (!protected_buf) {
        LOG_ERR("Failed to create protected buffer");
        return -ENOMEM;
    }

    LOG_INF("Created protected buffer (size: %zu)", protected_buf->size);

    /* Test normal operations */
    ret = ft_buffer_overflow_safe_copy(protected_buf, test_data, strlen(test_data));
    if (ret < 0) {
        LOG_ERR("Safe copy failed: %d", ret);
        goto cleanup;
    }
    LOG_INF("Safe copy successful");

    /* Verify buffer integrity */
    ret = ft_buffer_overflow_check_integrity(protected_buf);
    if (ret < 0) {
        LOG_ERR("Buffer integrity check failed: %d", ret);
        goto cleanup;
    }
    LOG_INF("Buffer integrity verified");

    /* Test reading from protected buffer */
    memset(read_buffer, 0, sizeof(read_buffer));
    memcpy(read_buffer, protected_buf->data, strlen(test_data));
    LOG_INF("Read from protected buffer: '%s'", read_buffer);

    /* Test boundary conditions */
    char large_data[64];
    memset(large_data, 'X', sizeof(large_data) - 1);
    large_data[sizeof(large_data) - 1] = '\0';

    LOG_INF("Testing overflow protection with oversized data...");
    ret = ft_buffer_overflow_safe_copy(protected_buf, large_data, sizeof(large_data));
    if (ret == -EOVERFLOW) {
        LOG_INF("Overflow correctly detected and prevented");
    } else {
        LOG_ERR("Expected overflow detection failed");
        ret = -EFAULT;
        goto cleanup;
    }

    /* Force integrity check */
    ret = ft_buffer_overflow_force_check();
    LOG_INF("Forced integrity check found %d violations", ret);

    /* Get statistics */
    ret = ft_buffer_overflow_get_stats(&stats);
    if (ret == 0) {
        LOG_INF("Buffer overflow statistics:");
        LOG_INF("  Buffers protected: %u", stats.buffers_protected);
        LOG_INF("  Integrity checks: %u", stats.integrity_checks);
        LOG_INF("  Violations detected: %u", stats.violations_detected);
        LOG_INF("  Repairs performed: %u", stats.repairs_performed);
        LOG_INF("  False positives: %u", stats.false_positives);
    }

    ret = 0;

cleanup:
    /* Clean up */
    if (protected_buf) {
        ft_buffer_overflow_destroy_protected(protected_buf);
    }

    LOG_INF("Buffer overflow protection test completed");
    return ret;
}
```

## src/deadlock_test.c
```c
/*
 * Copyright (c) 2025 Jack Ostapeic
 *
 * Deadlock Detection Test Module
 */

#include <zephyr/kernel.h>
#include <zephyr/logging/log.h>
#include <zephyr/fault_tolerance/ft_deadlock.h>

LOG_MODULE_REGISTER(deadlock_test, LOG_LEVEL_INF);

/* Test mutexes */
static struct k_mutex mutex_a;
static struct k_mutex mutex_b;

/* Thread stacks and data */
#define THREAD_STACK_SIZE 1024
K_THREAD_STACK_DEFINE(thread1_stack, THREAD_STACK_SIZE);
K_THREAD_STACK_DEFINE(thread2_stack, THREAD_STACK_SIZE);
static struct k_thread thread1_data, thread2_data;
static k_tid_t thread1_id, thread2_id;

/* Thread 1: acquires mutex_a, then tries to acquire mutex_b */
static void deadlock_thread1(void *p1, void *p2, void *p3)
{
    ARG_UNUSED(p1);
    ARG_UNUSED(p2);
    ARG_UNUSED(p3);

    LOG_INF("Thread 1: Starting");

    /* Report wait for mutex_a */
    ft_deadlock_report_wait(k_current_get(), &mutex_a);
    
    LOG_INF("Thread 1: Acquiring mutex A");
    k_mutex_lock(&mutex_a, K_FOREVER);
    
    /* Report successful acquisition */
    ft_deadlock_report_acquire(k_current_get(), &mutex_a);
    LOG_INF("Thread 1: Acquired mutex A");

    /* Delay to let thread 2 acquire mutex_b */
    k_sleep(K_MSEC(100));

    /* Now try to acquire mutex_b (potential deadlock) */
    LOG_INF("Thread 1: Trying to acquire mutex B");
    ft_deadlock_report_wait(k_current_get(), &mutex_b);
    
    int ret = k_mutex_lock(&mutex_b, K_MSEC(2000));
    if (ret == 0) {
        ft_deadlock_report_acquire(k_current_get(), &mutex_b);
        LOG_INF("Thread 1: Acquired mutex B");
        k_mutex_unlock(&mutex_b);
        ft_deadlock_report_release(k_current_get(), &mutex_b);
    } else {
        LOG_INF("Thread 1: Failed to acquire mutex B (timeout)");
    }

    k_mutex_unlock(&mutex_a);
    ft_deadlock_report_release(k_current_get(), &mutex_a);
    LOG_INF("Thread 1: Released mutex A");
}

/* Thread 2: acquires mutex_b, then tries to acquire mutex_a */
static void deadlock_thread2(void *p1, void *p2, void *p3)
{
    ARG_UNUSED(p1);
    ARG_UNUSED(p2);
    ARG_UNUSED(p3);

    LOG_INF("Thread 2: Starting");

    /* Small delay to let thread 1 start first */
    k_sleep(K_MSEC(50));

    /* Report wait for mutex_b */
    ft_deadlock_report_wait(k_current_get(), &mutex_b);
    
    LOG_INF("Thread 2: Acquiring mutex B");
    k_mutex_lock(&mutex_b, K_FOREVER);
    
    /* Report successful acquisition */
    ft_deadlock_report_acquire(k_current_get(), &mutex_b);
    LOG_INF("Thread 2: Acquired mutex B");

    /* Delay to create deadlock scenario */
    k_sleep(K_MSEC(100));

    /* Now try to acquire mutex_a (potential deadlock) */
    LOG_INF("Thread 2: Trying to acquire mutex A");
    ft_deadlock_report_wait(k_current_get(), &mutex_a);
    
    int ret = k_mutex_lock(&mutex_a, K_MSEC(2000));
    if (ret == 0) {
        ft_deadlock_report_acquire(k_current_get(), &mutex_a);
        LOG_INF("Thread 2: Acquired mutex A");
        k_mutex_unlock(&mutex_a);
        ft_deadlock_report_release(k_current_get(), &mutex_a);
    } else {
        LOG_INF("Thread 2: Failed to acquire mutex A (timeout)");
    }

    k_mutex_unlock(&mutex_b);
    ft_deadlock_report_release(k_current_get(), &mutex_b);
    LOG_INF("Thread 2: Released mutex B");
}

/* Test the deadlock detection module */
int deadlock_test(void)
{
    int ret;
    struct ft_deadlock_stats stats;

    LOG_INF("=== Deadlock Detection Test ===");

    /* Initialize mutexes */
    k_mutex_init(&mutex_a);
    k_mutex_init(&mutex_b);

    /* Register resources for monitoring */
    ret = ft_deadlock_register_resource(&mutex_a, "mutex_a");
    if (ret < 0) {
        LOG_ERR("Failed to register mutex A: %d", ret);
        return ret;
    }

    ret = ft_deadlock_register_resource(&mutex_b, "mutex_b");
    if (ret < 0) {
        LOG_ERR("Failed to register mutex B: %d", ret);
        return ret;
    }

    /* Create threads that will potentially deadlock */
    thread1_id = k_thread_create(&thread1_data, thread1_stack,
                                K_THREAD_STACK_SIZEOF(thread1_stack),
                                deadlock_thread1, NULL, NULL, NULL,
                                K_PRIO_PREEMPT(5), 0, K_NO_WAIT);

    thread2_id = k_thread_create(&thread2_data, thread2_stack,
                                K_THREAD_STACK_SIZEOF(thread2_stack),
                                deadlock_thread2, NULL, NULL, NULL,
                                K_PRIO_PREEMPT(5), 0, K_NO_WAIT);

    /* Register threads for monitoring */
    ret = ft_deadlock_register_thread(thread1_id, "deadlock_thread_1");
    if (ret < 0) {
        LOG_ERR("Failed to register thread 1: %d", ret);
    }

    ret = ft_deadlock_register_thread(thread2_id, "deadlock_thread_2");
    if (ret < 0) {
        LOG_ERR("Failed to register thread 2: %d", ret);
    }

    /* Let threads run and monitor for deadlocks */
    LOG_INF("Monitoring for deadlocks...");
    
    for (int i = 0; i < 30; i++) {  /* Monitor for 3 seconds */
        k_sleep(K_MSEC(100));
        
        /* Force deadlock check */
        uint32_t deadlocks = ft_deadlock_force_check();
        if (deadlocks > 0) {
            LOG_INF("Deadlock detection found %u potential deadlocks", deadlocks);
        }
    }

    /* Wait for threads to complete */
    k_thread_join(thread1_id, K_MSEC(5000));
    k_thread_join(thread2_id, K_MSEC(5000));

    /* Check for circular dependencies */
    uint32_t circular = ft_deadlock_check_circular_dependencies();
    LOG_INF("Circular dependency check found %u instances", circular);

    /* Check for timeout-based deadlocks */
    uint32_t timeouts = ft_deadlock_check_timeouts();
    LOG_INF("Timeout-based deadlock check found %u instances", timeouts);

    /* Get statistics */
    ret = ft_deadlock_get_stats(&stats);
    if (ret == 0) {
        LOG_INF("Deadlock detection statistics:");
        LOG_INF("  Resources monitored: %u", stats.resources_monitored);
        LOG_INF("  Threads monitored: %u", stats.threads_monitored);
        LOG_INF("  Deadlocks detected: %u", stats.deadlocks_detected);
        LOG_INF("  Deadlocks resolved: %u", stats.deadlocks_resolved);
        LOG_INF("  Resource preemptions: %u", stats.resource_preemptions);
    }

    /* Clean up */
    ft_deadlock_unregister_resource(&mutex_a);
    ft_deadlock_unregister_resource(&mutex_b);
    ft_deadlock_unregister_thread(thread1_id);
    ft_deadlock_unregister_thread(thread2_id);

    LOG_INF("Deadlock detection test completed");
    return 0;
}
```

## src/race_condition_test.c
```c
/*
 * Copyright (c) 2025 Jack Ostapeic
 *
 * Race Condition Detection Test Module
 */

#include <zephyr/kernel.h>
#include <zephyr/logging/log.h>
#include <zephyr/fault_tolerance/ft_race_condition.h>

LOG_MODULE_REGISTER(race_condition_test, LOG_LEVEL_INF);

/* Shared resource for testing */
static volatile int shared_counter = 0;
static volatile bool test_running = false;

/* Thread stacks and data */
#define THREAD_STACK_SIZE 1024
K_THREAD_STACK_DEFINE(reader1_stack, THREAD_STACK_SIZE);
K_THREAD_STACK_DEFINE(reader2_stack, THREAD_STACK_SIZE);
K_THREAD_STACK_DEFINE(writer1_stack, THREAD_STACK_SIZE);
K_THREAD_STACK_DEFINE(writer2_stack, THREAD_STACK_SIZE);

static struct k_thread reader1_data, reader2_data;
static struct k_thread writer1_data, writer2_data;
static k_tid_t reader1_id, reader2_id, writer1_id, writer2_id;

/* Reader thread 1 */
static void race_reader1(void *p1, void *p2, void *p3)
{
    ARG_UNUSED(p1);
    ARG_UNUSED(p2);
    ARG_UNUSED(p3);

    LOG_INF("Reader 1: Starting");

    while (test_running) {
        /* Report read access */
        FT_RACE_READ(&shared_counter, sizeof(shared_counter));
        
        volatile int local_copy = shared_counter;
        LOG_DBG("Reader 1: Counter = %d", local_copy);
        
        k_sleep(K_MSEC(50));
    }
    
    LOG_INF("Reader 1: Finished");
}

/* Reader thread 2 */
static void race_reader2(void *p1, void *p2, void *p3)
{
    ARG_UNUSED(p1);
    ARG_UNUSED(p2);
    ARG_UNUSED(p3);

    LOG_INF("Reader 2: Starting");

    while (test_running) {
        /* Report read access */
        FT_RACE_READ(&shared_counter, sizeof(shared_counter));
        
        volatile int local_copy = shared_counter;
        LOG_DBG("Reader 2: Counter = %d", local_copy);
        
        k_sleep(K_MSEC(75));
    }
    
    LOG_INF("Reader 2: Finished");
}

/* Writer thread 1 */
static void race_writer1(void *p1, void *p2, void *p3)
{
    ARG_UNUSED(p1);
    ARG_UNUSED(p2);
    ARG_UNUSED(p3);

    LOG_INF("Writer 1: Starting");
    
    int write_count = 0;

    while (test_running && write_count < 10) {
        /* Report write access */
        FT_RACE_WRITE(&shared_counter, sizeof(shared_counter));
        
        /* Simulate non-atomic operation */
        volatile int temp = shared_counter;
        k_sleep(K_USEC(100));  /* Small delay to increase race condition probability */
        shared_counter = temp + 1;
        
        write_count++;
        LOG_DBG("Writer 1: Incremented counter to %d", shared_counter);
        
        k_sleep(K_MSEC(100));
    }
    
    LOG_INF("Writer 1: Finished (%d writes)", write_count);
}

/* Writer thread 2 */
static void race_writer2(void *p1, void *p2, void *p3)
{
    ARG_UNUSED(p1);
    ARG_UNUSED(p2);
    ARG_UNUSED(p3);

    LOG_INF("Writer 2: Starting");
    
    int write_count = 0;

    while (test_running && write_count < 10) {
        /* Report write access */
        FT_RACE_WRITE(&shared_counter, sizeof(shared_counter));
        
        /* Simulate non-atomic operation */
        volatile int temp = shared_counter;
        k_sleep(K_USEC(150));  /* Different timing to create race conditions */
        shared_counter = temp + 2;
        
        write_count++;
        LOG_DBG("Writer 2: Incremented counter to %d", shared_counter);
        
        k_sleep(K_MSEC(120));
    }
    
    LOG_INF("Writer 2: Finished (%d writes)", write_count);
}

/* Test the race condition detection module */
int race_condition_test(void)
{
    int ret;
    struct ft_race_stats stats;
    struct ft_race_detection detection;

    LOG_INF("=== Race Condition Detection Test ===");

    /* Register shared resource for monitoring */
    ret = ft_race_register_resource(&shared_counter, sizeof(shared_counter), "shared_counter");
    if (ret < 0) {
        LOG_ERR("Failed to register shared resource: %d", ret);
        return ret;
    }

    /* Initialize shared counter */
    shared_counter = 0;
    test_running = true;

    /* Create threads that will access shared resource */
    reader1_id = k_thread_create(&reader1_data, reader1_stack,
                                K_THREAD_STACK_SIZEOF(reader1_stack),
                                race_reader1, NULL, NULL, NULL,
                                K_PRIO_PREEMPT(6), 0, K_NO_WAIT);

    reader2_id = k_thread_create(&reader2_data, reader2_stack,
                                K_THREAD_STACK_SIZEOF(reader2_stack),
                                race_reader2, NULL, NULL, NULL,
                                K_PRIO_PREEMPT(6), 0, K_NO_WAIT);

    writer1_id = k_thread_create(&writer1_data, writer1_stack,
                                K_THREAD_STACK_SIZEOF(writer1_stack),
                                race_writer1, NULL, NULL, NULL,
                                K_PRIO_PREEMPT(5), 0, K_NO_WAIT);

    writer2_id = k_thread_create(&writer2_data, writer2_stack,
                                K_THREAD_STACK_SIZEOF(writer2_stack),
                                race_writer2, NULL, NULL, NULL,
                                K_PRIO_PREEMPT(5), 0, K_NO_WAIT);

    /* Register threads for monitoring */
    ft_race_register_thread(reader1_id, "reader_1");
    ft_race_register_thread(reader2_id, "reader_2");
    ft_race_register_thread(writer1_id, "writer_1");
    ft_race_register_thread(writer2_id, "writer_2");

    /* Let threads run and monitor for race conditions */
    LOG_INF("Monitoring for race conditions...");
    
    for (int i = 0; i < 50; i++) {  /* Monitor for 5 seconds */
        k_sleep(K_MSEC(100));
        
        /* Check for concurrent access patterns */
        ret = ft_race_check_concurrent_access(&detection);
        if (ret > 0) {
            LOG_INF("Race condition detected! Type: %d, Time diff: %llu us", 
                   detection.conflict_type, detection.time_difference);
        }
        
        /* Force race condition check */
        uint32_t races = ft_race_force_check();
        if (races > 0) {
            LOG_INF("Force check detected %u race conditions", races);
        }

        /* Update Lamport clock periodically */
        ft_race_update_lamport_clock(ft_race_get_lamport_clock() + 1);
    }

    /* Stop test threads */
    test_running = false;

    /* Wait for threads to complete */
    k_thread_join(reader1_id, K_MSEC(2000));
    k_thread_join(reader2_id, K_MSEC(2000));
    k_thread_join(writer1_id, K_MSEC(2000));
    k_thread_join(writer2_id, K_MSEC(2000));

    LOG_INF("Final counter value: %d", shared_counter);

    /* Test synchronization */
    LOG_INF("Testing synchronization...");
    ret = ft_race_synchronize_access(&shared_counter, 1000);
    if (ret == 0) {
        LOG_INF("Synchronization successful");
        
        /* Perform synchronized access */
        FT_RACE_WRITE(&shared_counter, sizeof(shared_counter));
        shared_counter = 1000;
        LOG_INF("Synchronized write: counter = %d", shared_counter);
    } else {
        LOG_ERR("Synchronization failed: %d", ret);
    }

    /* Get statistics */
    ret = ft_race_get_stats(&stats);
    if (ret == 0) {
        LOG_INF("Race condition detection statistics:");
        LOG_INF("  Accesses monitored: %u", stats.total_accesses_monitored);
        LOG_INF("  Concurrent accesses: %u", stats.concurrent_accesses_detected);
        LOG_INF("  Race conditions detected: %u", stats.race_conditions_detected);
        LOG_INF("  Race conditions prevented: %u", stats.race_conditions_prevented);
        LOG_INF("  Synchronizations performed: %u", stats.synchronizations_performed);
        LOG_INF("  Protected resources: %u", stats.protected_resources);
    }

    /* Clean up */
    ft_race_unregister_resource(&shared_counter);

    LOG_INF("Race condition detection test completed");
    return 0;
}
```

## src/stack_overflow_test.c
```c
/*
 * Copyright (c) 2025 Jack Ostapeic
 *
 * Stack Overflow Protection Test Module
 */

#include <zephyr/kernel.h>
#include <zephyr/logging/log.h>
#include <zephyr/fault_tolerance/ft_stack_overflow.h>

LOG_MODULE_REGISTER(stack_overflow_test, LOG_LEVEL_INF);

/* Test thread that will consume stack space */
static void stack_consuming_thread(void *p1, void *p2, void *p3)
{
    ARG_UNUSED(p1);
    ARG_UNUSED(p2);
    ARG_UNUSED(p3);

    char large_buffer[1024];
    volatile int counter = 0;

    LOG_INF("Stack consuming thread started");

    /* Fill buffer to use stack space */
    for (int i = 0; i < sizeof(large_buffer); i++) {
        large_buffer[i] = (char)(i & 0xFF);
        counter++;
        
        /* Let monitoring happen */
        if (counter % 100 == 0) {
            k_sleep(K_MSEC(10));
        }
    }

    LOG_INF("Stack consuming thread completed normally");
}

/* Thread stack and ID */
#define STACK_SIZE 2048
K_THREAD_STACK_DEFINE(test_thread_stack, STACK_SIZE);
static struct k_thread test_thread_data;
static k_tid_t test_thread_id;

/* Test the stack overflow protection module */
int stack_overflow_test(void)
{
    int ret;
    struct ft_stack_overflow_stats stats;

    LOG_INF("=== Stack Overflow Protection Test ===");

    /* Register current thread for monitoring */
    ret = ft_stack_overflow_register_thread(k_current_get(), "main_thread");
    if (ret < 0) {
        LOG_ERR("Failed to register main thread: %d", ret);
        return ret;
    }

    /* Create test thread */
    test_thread_id = k_thread_create(&test_thread_data, test_thread_stack,
                                   K_THREAD_STACK_SIZEOF(test_thread_stack),
                                   stack_consuming_thread,
                                   NULL, NULL, NULL,
                                   K_PRIO_PREEMPT(7), 0, K_NO_WAIT);

    /* Register test thread for monitoring */
    ret = ft_stack_overflow_register_thread(test_thread_id, "stack_test_thread");
    if (ret < 0) {
        LOG_ERR("Failed to register test thread: %d", ret);
        k_thread_abort(test_thread_id);
        return ret;
    }

    /* Let test thread run and be monitored */
    k_sleep(K_MSEC(3000));

    /* Get statistics */
    ret = ft_stack_overflow_get_stats(&stats);
    if (ret == 0) {
        LOG_INF("Stack overflow statistics:");
        LOG_INF("  Threads monitored: %u", stats.threads_monitored);
        LOG_INF("  Checks performed: %u", stats.checks_performed);
        LOG_INF("  Violations detected: %u", stats.violations_detected);
        LOG_INF("  Threads suspended: %u", stats.threads_suspended);
        LOG_INF("  False positives: %u", stats.false_positives);
    }

    /* Clean up */
    k_thread_abort(test_thread_id);
    ft_stack_overflow_unregister_thread(test_thread_id);
    ft_stack_overflow_unregister_thread(k_current_get());

    LOG_INF("Stack overflow protection test completed");
    return 0;
}
```
